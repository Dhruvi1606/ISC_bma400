## boards/arm/pet_tracker/Kconfig.board
```kconfig
# Copyright (c) 2024 Nordic Semiconductor ASA
# SPDX-License-Identifier: Apache-2.0

config BOARD_PET_TRACKER
	bool "Pet Tracker"
	depends on SOC_NRF52840_QIAA
```

## boards/arm/pet_tracker/Kconfig.defconfig
```kconfig
# Copyright (c) 2024 Nordic Semiconductor ASA
# SPDX-License-Identifier: Apache-2.0

if BOARD_PET_TRACKER

config BOARD
	default "pet_tracker"

config BT_CTLR
   default BT


endif
```
